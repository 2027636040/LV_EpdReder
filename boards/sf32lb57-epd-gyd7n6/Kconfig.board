## boards/sf32lb57-epd-gyd7n6/Kconfig.board
```kconfig
config ASIC
    bool
    default y

config BSP_SUPPORT_DPI
    bool
    default y

config TOUCH_IRQ_PIN
    int
    default 3

config EPD_TPS_I2C_DEVICE_NAME
    string
    default "i2c1"

config EPD_TPS_WAKEUP_PIN
    int
    default 42

config EPD_TPS_PWRCOM_PIN
    int
    default 43

config EPD_TPS_PWRUP_PIN
    int
    default 44

config EPD_TPS_GOOD_PIN
    int
    default 52

config EPD_VCOM_MV
    int "Panel VCOM magnitude in mV (use panel label)"
    range 1500 2500
    default 2100
```

## boards/sf32lb57-epd-gyd7n6/hcpu/Kconfig.board
```kconfig
config BSP_USING_BOARD_SF32LB57_EPD_GYD7N6
    bool
    default y
    select SOC_SF32LB57X
    select SOC_SF32LB57GYD7N6
    select BF0_HCPU
    select TSC_USING_FT5446U if BSP_USING_TOUCHD

rsource "../Kconfig.board"
```

## boards/sf32lb57-lcd-gyd7n6_epd/hcpu/Kconfig.board
```kconfig
config BSP_USING_BOARD_SF32LB57_LCD_GYD7N6_EPD
    bool
    default y
    select SOC_SF32LB57X
    select SOC_SF32LB57GYD7N6
    select BF0_HCPU

rsource "../Kconfig.board"
```

## components/sdcard/Kconfig
```kconfig
menuconfig PKG_USING_EPD_SDCARD
    bool "SD card media lifecycle service"
    depends on RT_USING_PIN && RT_USING_SDIO && BSP_USING_SD_LINE
    depends on RT_USING_DFS && RT_USING_DFS_ELMFAT
    depends on SDIO_CARD_MODE = 0 && SD_INSERT_DETECT_PIN >= 0
    default n
    help
        Manage SD card detection and DFS FAT mount/unmount from a worker.
        The platform supplies the card configuration and acknowledges release
        of media users before unmounting. Requires per-host change request
        status support in the SiFli MMC/SD core.
```

## components/sdcard/tests/Kconfig
```kconfig
mainmenu "SD card package configuration test"

config RT_USING_PIN
    bool "GPIO"
    default y
config RT_USING_SDIO
    bool "MMC/SD core"
    default y
config BSP_USING_SD_LINE
    bool "SiFli SDIO"
    default y
config RT_USING_DFS
    bool "DFS"
    default y
config RT_USING_DFS_ELMFAT
    bool "FAT"
    default y
config SDIO_CARD_MODE
    int "Card type"
    default 0
config SD_INSERT_DETECT_PIN
    int "Detection pin"
    default 11

rsource "../Kconfig"
```
